## boards/shields/lily58/boards/Kconfig.defconfig
```kconfig
if SHIELD_LILY58_LEFT

config BT_DEVICE_NAME
    default "Tom-KB-L"

config ZMK_SPLIT_ROLE_CENTRAL
    default y

endif

if SHIELD_LILY58_RIGHT

config BT_DEVICE_NAME
    default "Tom-KB-R"

config ZMK_SPLIT_ROLE_CENTRAL
    default n

endif
```

## config/boards/shields/lily58/Kconfig.defconfig
```kconfig
config BT_DEVICE_NAME
    default "Tom-KB-L" if SHIELD_LILY58_LEFT
    default "Tom-KB-R" if SHIELD_LILY58_RIGHT
```
